## config/boards/shields/soroka/Kconfig.defconfig
```kconfig
# Copyright (c) 2022 The ZMK Contributors
# SPDX-License-Identifier: MIT
if SHIELD_SOROKA
	config ZMK_KEYBOARD_NAME
		default "Soroka"
endif
```

## config/boards/shields/soroka/Kconfig.shield
```kconfig
# Copyright (c) 2022 The ZMK Contributors
# SPDX-License-Identifier: MIT

config SHIELD_SOROKA
    def_bool $(shields_list_contains,soroka)
```
